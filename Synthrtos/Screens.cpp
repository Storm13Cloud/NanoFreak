#include "Screens.h"
#include "Config.h"
#include <pgmspace.h>
#include <AMY-Arduino.h>

// 'MainScreenSEQ', 128x64px
const unsigned char MainScreenSEQ [] PROGMEM = {
	0xff, 0xff, 0xff, 0xff, 0xff, 0xff, 0xff, 0xff, 0xff, 0xff, 0xff, 0xff, 0xff, 0xff, 0xff, 0xff, 
	0x83, 0xc0, 0xe1, 0x03, 0xf8, 0x07, 0x80, 0x81, 0x81, 0x01, 0xe0, 0x1f, 0xc0, 0x87, 0x03, 0xc1, 
	0x5d, 0x73, 0x38, 0x1f, 0x0e, 0x7f, 0xde, 0xde, 0x7b, 0x7b, 0xfe, 0x70, 0xf8, 0x1c, 0xce, 0xba, 
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	0xff, 0xff, 0xff, 0xff, 0xff, 0xff, 0xff, 0xff, 0xff, 0xff, 0xff, 0xff, 0xff, 0xff, 0xff, 0xff
};

// 'MainScreenSettings', 128x64px
const unsigned char MainScreenSettings [] PROGMEM = {
	0xff, 0xff, 0xff, 0xff, 0xff, 0xff, 0xff, 0xff, 0xff, 0xff, 0xff, 0xff, 0xff, 0xff, 0xff, 0xff, 
	0x83, 0xc0, 0xe1, 0x03, 0xf8, 0x07, 0x80, 0x81, 0x81, 0x01, 0xe0, 0x1f, 0xc0, 0x87, 0x03, 0xc1, 
	0x5d, 0x73, 0x38, 0x1f, 0x0e, 0x7f, 0xde, 0xde, 0x7b, 0x7b, 0xfe, 0x70, 0xf8, 0x1c, 0xce, 0xba, 
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	0xff, 0xff, 0xff, 0xff, 0xff, 0xff, 0xff, 0xff, 0xff, 0xff, 0xff, 0xff, 0xff, 0xff, 0xff, 0xff
};

// 'MainScreenUser', 128x64px
const unsigned char MainScreenUser [] PROGMEM = {
	0xff, 0xff, 0xff, 0xff, 0xff, 0xff, 0xff, 0xff, 0xff, 0xff, 0xff, 0xff, 0xff, 0xff, 0xff, 0xff, 
	0x83, 0xc0, 0xe1, 0x03, 0xf8, 0x07, 0x80, 0x81, 0x81, 0x01, 0xe0, 0x1f, 0xc0, 0x87, 0x03, 0xc1, 
	0x5d, 0x73, 0x38, 0x1f, 0x0e, 0x7f, 0xde, 0xde, 0x7b, 0x7b, 0xfe, 0x70, 0xf8, 0x1c, 0xce, 0xba, 
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	0xff, 0xff, 0xff, 0xff, 0xff, 0xff, 0xff, 0xff, 0xff, 0xff, 0xff, 0xff, 0xff, 0xff, 0xff, 0xff
};

// 'MainScreenPreset', 128x64px
const unsigned char MainScreenPreset [] PROGMEM = {
	0xff, 0xff, 0xff, 0xff, 0xff, 0xff, 0xff, 0xff, 0xff, 0xff, 0xff, 0xff, 0xff, 0xff, 0xff, 0xff, 
	0x83, 0xc0, 0xe1, 0x03, 0xf8, 0x07, 0x80, 0x81, 0x81, 0x01, 0xe0, 0x1f, 0xc0, 0x87, 0x03, 0xc1, 
	0x5d, 0x73, 0x38, 0x1f, 0x0e, 0x7f, 0xde, 0xde, 0x7b, 0x7b, 0xfe, 0x70, 0xf8, 0x1c, 0xce, 0xba, 
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	0xff, 0xff, 0xff, 0xff, 0xff, 0xff, 0xff, 0xff, 0xff, 0xff, 0xff, 0xff, 0xff, 0xff, 0xff, 0xff
};


// Structure defining navigation routing for every individual screen
struct ScreenDef {
  const unsigned char* bitmap; 
  const char* name;            
  int nextScreenOnSelect;      
  int siblingLeft;             
  int siblingRight;            
};

const unsigned char* const epd_bitmap_allArray[NUM_SCREENS] = {
	MainScreenPreset,      
	MainScreenUser,        
	MainScreenSEQ,         
	MainScreenSettings,    
	nullptr,                          
	nullptr,                          
	nullptr,                          
	nullptr,                          
	nullptr,                          
	nullptr                           
};

int currentScreen = SCREEN_PRESET;

// --- Parametric States & Default Values ---
bool isEditingValue = false;   // Allocation
int presetNumber = 0;          // Default Preset: 0
int seqTempo = 120;            // Default Tempo: 120 BPM
int seqLength = 16;            // Default Length: 16 Steps

// --- MENU MAP CONFIGURATION TABLE ---
// Note: We changed nextScreenOnSelect to -1 for Edit, Tempo, and Length so they toggle Edit Mode in-place
const ScreenDef screensTable[NUM_SCREENS] = {
  // SCREEN_PRESET (0)
  { MainScreenPreset, "Preset Select", SCREEN_PRESET_SUB_EDIT, SCREEN_SETTINGS, SCREEN_USER },
  
  // SCREEN_USER (1)
  { MainScreenUser, "User Profiles", -1, SCREEN_PRESET, SCREEN_SEQ },
  
  // SCREEN_SEQ (2)
  { MainScreenSEQ, "Sequencer", SCREEN_SEQ_TEMPO, SCREEN_USER, SCREEN_SETTINGS },
  
  // SCREEN_SETTINGS (3)
  { MainScreenSettings, "Settings", -1, SCREEN_SEQ, SCREEN_PRESET },
  
  // SCREEN_PRESET_SUB_EDIT (4) -> No deep sub-page (-1). Click toggles Edit Mode
  { nullptr, "Preset: Edit", -1, SCREEN_PRESET_SUB_DELETE, SCREEN_PRESET_SUB_SAVE },
  
  // SCREEN_PRESET_SUB_SAVE (5)
  { nullptr, "Preset: Save", -1, SCREEN_PRESET_SUB_EDIT, SCREEN_PRESET_SUB_DELETE },
  
  // SCREEN_PRESET_SUB_DELETE (6)
  { nullptr, "Preset: Delete", -1, SCREEN_PRESET_SUB_SAVE, SCREEN_PRESET_SUB_EDIT },
  
  // SCREEN_PRESET_VOLUME_CONTROL (7)
  { nullptr, "Volume Adjustment", -1, SCREEN_PRESET_VOLUME_CONTROL, SCREEN_PRESET_VOLUME_CONTROL },
  
  // SCREEN_SEQ_TEMPO (8) -> Click toggles Edit Mode
  { nullptr, "Set BPM", -1, SCREEN_SEQ_LENGTH, SCREEN_SEQ_LENGTH },
  
  // SCREEN_SEQ_LENGTH (9) -> Click toggles Edit Mode
  { nullptr, "Set Grid Length", -1, SCREEN_SEQ_TEMPO, SCREEN_SEQ_TEMPO }
};

#define MAX_HISTORY_DEPTH 10
int screenHistory[MAX_HISTORY_DEPTH] = {0};
int historyPointer = 0;

void pushHistory(int screen) {
  if (historyPointer < MAX_HISTORY_DEPTH) {
    screenHistory[historyPointer] = screen;
    historyPointer++;
  }
}

int popHistory() {
  if (historyPointer > 0) {
    historyPointer--;
    return screenHistory[historyPointer];
  }
  return -1; 
}

// Adjusts the active variable based on what editing screen we are on
void adjustActiveParameter(int8_t direction) {
  switch (currentScreen) {
    case SCREEN_PRESET_SUB_EDIT:
      changePresetAndKeepEnvelope(direction);
      break;

    case SCREEN_SEQ_TEMPO:
      seqTempo += direction;
      seqTempo = constrain(seqTempo, 40, 240); // Standard BPM range
      Serial.print("New Tempo: ");
      Serial.println(seqTempo);
      break;

    case SCREEN_SEQ_LENGTH:
      seqLength += direction;
      seqLength = constrain(seqLength, 1, 64); // Step count range
      Serial.print("New Length: ");
      Serial.println(seqLength);
      break;

    default:
      break;
  }
}

void handleScreenNavigation(int8_t direction) {
  if (isEditingValue) {
    // Intercept encoder movement to increase/decrease the parameter instead of scrolling screens
    adjustActiveParameter(direction);
  } else {
    // Normal scroll navigation
    if (direction > 0) {
      int target = screensTable[currentScreen].siblingRight;
      if (target != -1) currentScreen = target;
    } 
    else if (direction < 0) {
      int target = screensTable[currentScreen].siblingLeft;
      if (target != -1) currentScreen = target;
    }
    Serial.print("Screen Name: ");
    Serial.println(screensTable[currentScreen].name);
  }
}

void handleScreenClick() {
  int target = screensTable[currentScreen].nextScreenOnSelect;
  if (target != -1) {
    // Navigate down into a linked sub-screen
    pushHistory(currentScreen); 
    currentScreen = target;
    Serial.print("Entered Sub-Screen: ");
    Serial.println(screensTable[currentScreen].name);
  } else {
    // If the screen has no linked target, toggle edit mode in-place (for Edit, Tempo, Length)
    if (currentScreen == SCREEN_PRESET_SUB_EDIT || 
        currentScreen == SCREEN_SEQ_TEMPO || 
        currentScreen == SCREEN_SEQ_LENGTH) {
      isEditingValue = !isEditingValue;
      Serial.print("Editing Mode: ");
      Serial.println(isEditingValue ? "ON" : "OFF");
    }
  }
}

void handleScreenHold() {
  if (isEditingValue) {
    // If actively editing, holding acts as a cancel/exit from edit mode first
    isEditingValue = false;
    Serial.println("Edit Cancelled.");
    return;
  }

  int previous = popHistory();
  if (previous != -1) {
    currentScreen = previous;
    Serial.print("Returned to Parent: ");
    Serial.println(screensTable[currentScreen].name);
  }
}

const unsigned char* getCurrentScreenBitmap() {
  return screensTable[currentScreen].bitmap;
}

const char* getScreenName(int screenIndex) {
  if (screenIndex < 0 || screenIndex >= NUM_SCREENS) return "Menu";
  return screensTable[screenIndex].name;
}